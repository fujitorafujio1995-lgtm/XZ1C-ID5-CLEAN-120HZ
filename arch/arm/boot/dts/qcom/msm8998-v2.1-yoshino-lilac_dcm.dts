/dts-v1/;

#include "msm8998-v2.1.dtsi"
#include "msm8998-mdss-panels.dtsi"
#include "msm8998-mtp.dtsi"
#include "msm8998-yoshino-lilac_dcm.dtsi"

/ {
	model = "SoMC Lilac-DCM(MSM8998 v2.1)";
	compatible = "somc,lilac-dcm", "qcom,msm8998";
	qcom,board-id = <8 0>;
};
